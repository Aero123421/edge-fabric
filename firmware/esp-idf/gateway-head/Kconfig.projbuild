## firmware/esp-idf/gateway-head/Kconfig.projbuild
```kconfig
menu "Edge Fabric Gateway"

config EDGE_FABRIC_REQUIRE_REAL_BACKENDS
    bool "Fail startup when TinyUSB/SX1262 real backends are unavailable"
    default n
    help
        Production-oriented guard. When enabled, gateway-head refuses to
        fall back to the development USB/radio backends if real backend
        initialization fails. gateway_head_runtime_start() also rejects any
        configuration where either installed backend is marked development
        only, so tests cannot accidentally ship with a mixed real/dev path.

endmenu
```

## firmware/esp-idf/node-sdk/Kconfig.projbuild
```kconfig
menu "Edge Fabric Sleepy Leaf"

config EDGE_FABRIC_SLEEPY_USE_DEEP_SLEEP
    bool "Enter true ESP32 deep sleep between sleepy cycles"
    default n
    help
        When enabled, node-sdk publishes the compact sleep state, arms the
        timer wake source, and calls esp_deep_sleep_start() after each
        uplink/downlink cycle. Leave disabled for development smoke tests
        where the process should continue after light sleep.

config EDGE_FABRIC_SLEEPY_WAKE_INTERVAL_MS
    int "Sleepy wake interval in milliseconds"
    default 2000
    range 100 86400000
    help
        Timer wake interval used by both light sleep and deep sleep modes.

config EDGE_FABRIC_SLEEPY_ENABLE_RTC_PERSISTENCE
    bool "Persist sleepy policy state in RTC memory"
    default y
    help
        Keeps the next on-air sequence, maintenance cycle countdown, short
        ID, and recent command token cache across deep sleep wakeups.

config EDGE_FABRIC_SLEEPY_RECENT_COMMAND_TOKEN_CACHE_SIZE
    int "Recent command token cache entries"
    default 4
    range 1 8
    help
        Number of recent 16-bit command tokens retained to suppress
        duplicate terminal results. The selected size is part of the RTC
        state version so changing it invalidates stale retained state.

endmenu
```

## firmware/esp-idf/node-sdk/sdkconfig.defaults
```kconfig
CONFIG_IDF_TARGET="esp32s3"
CONFIG_PARTITION_TABLE_CUSTOM=y
CONFIG_PARTITION_TABLE_CUSTOM_FILENAME="../partitions.csv"
CONFIG_ESP_CONSOLE_USB_SERIAL_JTAG=y
# CONFIG_EDGE_FABRIC_SLEEPY_USE_DEEP_SLEEP is not set
CONFIG_EDGE_FABRIC_SLEEPY_WAKE_INTERVAL_MS=2000
CONFIG_EDGE_FABRIC_SLEEPY_ENABLE_RTC_PERSISTENCE=y
CONFIG_EDGE_FABRIC_SLEEPY_RECENT_COMMAND_TOKEN_CACHE_SIZE=4
```

## firmware/esp-idf/sdkconfig.defaults
```kconfig
CONFIG_PARTITION_TABLE_CUSTOM=y
CONFIG_PARTITION_TABLE_CUSTOM_FILENAME="partitions.csv"
CONFIG_PARTITION_TABLE_OFFSET=0x8000
CONFIG_ESP_CONSOLE_USB_CDC=y
CONFIG_ESP_SYSTEM_PANIC_PRINT_REBOOT=y
CONFIG_FREERTOS_HZ=1000
```
